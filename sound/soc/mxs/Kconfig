## sound/soc/mxs/Kconfig
```kconfig
menuconfig SND_MXS_SOC
	tristate "SoC Audio for Freescale MXS CPUs"
	depends on ARCH_MXS || COMPILE_TEST
	depends on COMMON_CLK
	select SND_SOC_GENERIC_DMAENGINE_PCM
	help
	  Say Y or M if you want to add support for codecs attached to
	  the MXS SAIF interface.


if SND_MXS_SOC

config SND_SOC_MXS_SGTL5000
	tristate "SoC Audio support for MXS boards with sgtl5000"
	depends on I2C
	select SND_SOC_SGTL5000
	help
	  Say Y if you want to add support for SoC audio on an MXS board with
	  a sgtl5000 codec.

config SND_SOC_MXS_UDA1380
	tristate "SoC Audio support for MXS boards with uda1380"
	depends on I2C
	select SND_SOC_UDA1380
	help
	  Say Y if you want to add support for SoC audio on an MXS board with
	  a uda1380 codec.

endif	# SND_MXS_SOC
```
